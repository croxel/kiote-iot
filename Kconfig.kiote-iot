## Kconfig.kiote-iot
```kconfig
menu "Croxel KIOTE IoT"

# This is a temporary solution to whitelist
# BOARD_CROXEL_KIOTE11_NRF9160_NS in compliance
config BOARD_CROXEL_KIOTE11_NRF9160_NS
	bool

endmenu
```

## boards/arm/croxel_kiote11_nrf9160/Kconfig.board
```kconfig
# Croxel's KIOTE/11 nRF9160 board configuration
#
# Copyright (c) 2019 Nordic Semiconductor ASA
# Copyright (c) 2021 Croxel Inc
#
# SPDX-License-Identifier: LicenseRef-Nordic-5-Clause

if SOC_NRF9160_SICA

config BOARD_CROXEL_KIOTE11_NRF9160
	bool "nRF9160 Croxel's KIOTE/11"

config BOARD_CROXEL_KIOTE11_NRF9160NS
	bool "nRF9160 Croxel's KIOTE/11 non-secure"

endif # SOC_NRF9160_SICA
```

## boards/arm/croxel_kiote11_nrf9160/croxel_kiote11_nrf9160ns_defconfig
```kconfig
# SPDX-License-Identifier: Apache-2.0

CONFIG_SOC_SERIES_NRF91X=y
CONFIG_SOC_NRF9160_SICA=y
CONFIG_BOARD_CROXEL_KIOTE11_NRF9160NS=y

# Enable MPU
CONFIG_ARM_MPU=y

# Enable hardware stack protection
CONFIG_HW_STACK_PROTECTION=y

# Enable TrustZone-M
CONFIG_ARM_TRUSTZONE_M=y

# This Board implies building Non-Secure firmware
CONFIG_TRUSTED_EXECUTION_NONSECURE=y

# Enable GPIO
CONFIG_GPIO=y

# Enable UARTE
CONFIG_SERIAL=y

# Enable console
CONFIG_CONSOLE=y
CONFIG_UART_CONSOLE=y
```

## boards/arm/croxel_module_nrf9160/Kconfig.board
```kconfig
# Croxel's Module nRF9160 board configuration
#
# Copyright (c) 2019 Nordic Semiconductor ASA
# Copyright (c) 2021 Croxel Inc
#
# SPDX-License-Identifier: LicenseRef-Nordic-5-Clause

if SOC_NRF9160_SICA

config BOARD_CROXEL_MODULE_NRF9160
	bool "nRF9160 Croxel's Module"

config BOARD_CROXEL_MODULE_NRF9160_NS
	bool "nRF9160 Croxel's Module non-secure"

endif # SOC_NRF9160_SICA
```

## boards/arm/croxel_module_nrf9160/croxel_module_nrf9160_defconfig
```kconfig
# SPDX-License-Identifier: Apache-2.0

CONFIG_SOC_SERIES_NRF91X=y
CONFIG_SOC_NRF9160_SICA=y
CONFIG_BOARD_CROXEL_MODULE_NRF9160=y

# Enable MPU
CONFIG_ARM_MPU=y

# Enable hardware stack protection
CONFIG_HW_STACK_PROTECTION=y

# Enable TrustZone-M
CONFIG_ARM_TRUSTZONE_M=y

# Enable GPIO
CONFIG_GPIO=y
```

## boards/arm/croxel_module_nrf9160/croxel_module_nrf9160_ns_defconfig
```kconfig
# SPDX-License-Identifier: Apache-2.0

CONFIG_SOC_SERIES_NRF91X=y
CONFIG_SOC_NRF9160_SICA=y
CONFIG_BOARD_CROXEL_MODULE_NRF9160_NS=y

# Enable MPU
CONFIG_ARM_MPU=y

# Enable hardware stack protection
CONFIG_HW_STACK_PROTECTION=y

# Enable TrustZone-M
CONFIG_ARM_TRUSTZONE_M=y

# This Board implies building Non-Secure firmware
CONFIG_TRUSTED_EXECUTION_NONSECURE=y

# Enable GPIO
CONFIG_GPIO=y

CONFIG_PINCTRL=y

# Enable RTT as main console output
CONFIG_USE_SEGGER_RTT=y
CONFIG_CONSOLE=y
CONFIG_RTT_CONSOLE=y
```

## boards/shields/module_nrf9160_host_demo/Kconfig.shield
```kconfig
config SHIELD_MODULE_NRF9160_HOST_DEMO
	def_bool $(shields_list_contains,module_nrf9160_host_demo)
```

## boards/shields/module_nrf9160_test_fixture/Kconfig.defconfig
```kconfig
if SHIELD_MODULE_NRF9160_TEST_FIXTURE

config GPIO
    default y

endif # SHIELD_MODULE_NRF9160_TEST_FIXTURE
```

## boards/shields/module_nrf9160_test_fixture/Kconfig.shield
```kconfig
config SHIELD_MODULE_NRF9160_TEST_FIXTURE
	def_bool $(shields_list_contains,module_nrf9160_test_fixture)
```

## boards/shields/module_nrf9160_test_widget/Kconfig.defconfig
```kconfig
if SHIELD_MODULE_NRF9160_TEST_WIDGET

config GPIO
    default y

endif # SHIELD_MODULE_NRF9160_TEST_WIDGET
```

## boards/shields/module_nrf9160_test_widget/Kconfig.shield
```kconfig
config SHIELD_MODULE_NRF9160_TEST_WIDGET
	def_bool $(shields_list_contains,module_nrf9160_test_widget)
```

## drivers/sensor/mc34x9/Kconfig
```kconfig
menuconfig MC34X9
    bool "MC34X9 3-Axis accelerometer driver"
    help
      Enable support for MC34X9 accelerometer driver
```

## dts/bindings/gpio/module-expansion-port.yaml
```yaml
description: |
    GPIO pins exposed through the expansion port of the nRF9160 module.
    
    These are provided through castellated pins which, when soldered on a
    carrier board, enable various functionalities.

compatible: "module-expansion-port"

include: [gpio-nexus.yaml, base.yaml]
```

## dts/bindings/sensor/memsic,mc34x9.yaml
```yaml
description: |
    The MC34X9 is a 3-Axis Accelerometer. See more info at:
    https://www.memsic.com/capacitive-accelerometer-26

compatible: "memsic,mc34x9"

include: i2c-device.yaml
```

## west.yml
```yaml
# The west manifest file (west.yml) for the Croxel's KIOTE IoT Repository of nRF Connect SDK (NCS).
#
# The per-workspace west configuration file, ncs/.west/config,
# specifies the location of this manifest file like this:
#
#     [manifest]
#     path = kiote-iot
#
# See the west documentation for more information:
#
# https://developer.nordicsemi.com/nRF_Connect_SDK/doc/latest/zephyr/guides/west/index.html

manifest:
  # This west.yml requires west 0.9 or later, because the "submodules"
  # feature used below was introduced then.
  version: "0.10"

  # "remotes" is a list of locations where git repositories are cloned
  # and fetched from.
  remotes:
    # nRF Connect SDK GitHub organization.
    - name: ncs
      url-base: https://github.com/nrfconnect

  # If not otherwise specified, the projects below should be obtained
  # from the ncs remote.
  defaults:
    remote: ncs

  # "projects" is a list of git repositories which make up the NCS
  # source code.
  projects:
    - name: nrf
      repo-path: sdk-nrf
      revision: v1.7.0
      path: nrf
      import: true

  # West-related configuration for the nrf repository.
  self:
    # This repository should be cloned to ncs/kiote-iot.
    path: kiote-iot
```
