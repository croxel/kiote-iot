/*
 * Copyright (c) 2019 Nordic Semiconductor ASA
 * Copyright (c) 2021 Croxel Inc
 *
 * SPDX-License-Identifier: LicenseRef-Nordic-5-Clause
 */

/dts-v1/;
#include <nordic/nrf9160_sica.dtsi>
#include "croxel_module_nrf9160_common.dts"

/ {
	chosen {
		zephyr,sram = &sram0;
		zephyr,flash = &flash0;
		zephyr,code-partition = &slot0_partition;
	};
};
